/** 任务6.四位七段数码管动态显示 **/
//==声明区====================================
#include	<reg52.h>  								// 定义头文件 
char code TAB[10]={	0xc0, 0xf9, 0xa4, 0xb0, 0x99,	// 数字0-4
				  	0x92, 0x82, 0xf8, 0x80, 0x98 };	// 数字5-9
char code display[4]={2,0,1,4}; 					// 欲显示的4个数字
char code scan[4]={0xfe,0xfd,0xfb,0xf7};			// 显示位的扫描信号
void delay1ms(int);									// 声明延迟函数 
//==主程序====================================
main()												// 主程序开始 
{
	char i;
	while(1)										// 无穷循环 
	{
		for (i=0;i<4;i++)							// 扫描8个数字
		{	
			P0=0xff;								// 共阳极，关闭数码管防止闪动
			P2=scan[i];								// 输出位扫描信号
			P0=TAB[display[i]];						// 输出段码
			delay1ms(1);							// 延迟1ms
		}											// 结束扫描1轮
	}
}
//==子程序====================================
/* 延迟函数,延迟约x 1ms */
void delay1ms(int x)								// 延迟函数开始 
{	int i,j;										// 声明整数变数i,j 
	for (i=0;i<x;i++)								// 计数x次,延迟x 1ms 
		for (j=0;j<120;j++);						// 计数120次，延迟1ms 
}													// 延迟函数结束 