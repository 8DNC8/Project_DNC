#include "hal_data.h"

#include "zf_common_headfile.h"
#include "servo_hold.h"
#include "brushless_driver.h"
#include "imu_process.h"
#include "imu_angle_display.h"
#include "balance_control.h"
#include "key_tune.h"
#include "nag_navigation.h"
#include "voice_control.h"
#include "camera_display.h"
#include "tof_follow.h"
#include "remote_control.h"

#define RUN_SERVO_HOLD_TEST (0)
#define RUN_BRUSHLESS_TEST  (0)
#define RUN_IMU660RB_TEST   (1)
#define RUN_IPS200_DISPLAY  (1)

/* FSP 鍦?SystemInit 涓淮鎶ょ殑 CPU 鏃堕挓棰戠巼锛圚z锛夛紝鐢ㄤ簬鎶?DWT 鍛ㄦ湡璁℃暟鎹㈢畻鎴愮 */
extern uint32_t SystemCoreClock;

/* DWT 鍛ㄦ湡璁℃暟鍣ㄥ瘎瀛樺櫒鍦板潃锛圕ortex-M85锛?*/
#define DWT_CTRL_REG    (0xE0001000UL)
#define DWT_CYCCNT_REG  (0xE0001004UL)
#define DEMCR_REG       (0xE000EDFCUL)

#define BRUSHLESS_TEST_DUTY     (3000)
#define BRUSHLESS_TEST_LEFT     (-BRUSHLESS_TEST_DUTY)
#define BRUSHLESS_TEST_RIGHT    (BRUSHLESS_TEST_DUTY)
#define BRUSHLESS_TEST_TIME_MS  (1200)
#define BRUSHLESS_TEST_STEP_MS  (20)

/* ===== 鍗℃璇婃柇锛氳鐩?FSP 鐨勫急寮傚父澶勭悊鍑芥暟 =====
 * 濡傛灉绋嬪簭椋炰簡/杩涗簡 HardFault 绛夊紓甯革紝璁?USER_LED(P110) 鎱㈤棯锛?
 * 姝ｅ父涓诲惊鐜槸蹇€熼棯鐑侊紙姣忔寰幆缈昏浆涓€娆★級銆傝繖鏍峰崱姝绘椂鐪?LED锛?
 *   鎱㈤棯 -> 杩涘紓甯镐簡锛堝唴瀛?鎸囬拡闂锛夛紱涓€鐩翠寒鎴栦竴鐩寸伃 -> 涓诲惊鐜崱鍦ㄦ寰幆閲屻€?*/
static void fault_led_report(void)
{
    volatile uint32_t wait;
    volatile uint32_t const * cfsr = (volatile uint32_t const *) 0xE000ED28UL;
    uint32_t code;

    /* 璇诲紓甯哥姸鎬佸瘎瀛樺櫒锛屽垽鏂紓甯哥被鍨嬶紝鐢?LED 杩為棯娆℃暟琛ㄧず */
    if(*cfsr & (1UL << 25))         code = 1;   /* 闄ら浂 DIVBYZERO */
    else if(*cfsr & (1UL << 24))    code = 2;   /* 闈炲榻愯闂?UNALIGNED */
    else if(*cfsr & (1UL << 4))     code = 3;   /* 鏍堟孩鍑?MSTKERR */
    else if(*cfsr & (1UL << 0))     code = 4;   /* 鎸囦护璁块棶瓒婄晫 IACCVIOL */
    else if(*cfsr & (1UL << 1))     code = 5;   /* 鏁版嵁璁块棶瓒婄晫 DACCVIOL */
    else if(*cfsr & (1UL << 9))     code = 6;   /* 绮剧‘鎬荤嚎閿?PRECISERR(閲庢寚閽? */
    else if(*cfsr & (1UL << 10))    code = 7;   /* 涓嶇簿纭€荤嚎閿?IMPRECISERR */
    else if(*cfsr & (1UL << 16))    code = 8;   /* 鏈畾涔夋寚浠?UNDEFINSTR */
    else                            code = 9;   /* 鍏跺畠/鐩存帴 HardFault */

    while(1)
    {
        /* 杩為棯 code 娆★紝鐒跺悗闀垮仠椤匡紝寰幆 */
        for(uint32_t n = 0; n < code; n++)
        {
            R_BSP_PinWrite(BSP_IO_PORT_01_PIN_10, BSP_IO_LEVEL_HIGH);
            for(wait = 0; wait < 6000000U; wait++) { }
            R_BSP_PinWrite(BSP_IO_PORT_01_PIN_10, BSP_IO_LEVEL_LOW);
            for(wait = 0; wait < 6000000U; wait++) { }
        }
        for(wait = 0; wait < 40000000U; wait++) { }
    }
}

void HardFault_Handler(void);
void MemManage_Handler(void);
void BusFault_Handler(void);
void UsageFault_Handler(void);
void HardFault_Handler(void)    { fault_led_report(); }
void MemManage_Handler(void)    { fault_led_report(); }
void BusFault_Handler(void)     { fault_led_report(); }
void UsageFault_Handler(void)   { fault_led_report(); }

/* 鍗℃瀹氫綅锛氫富寰幆闃舵鏍囪锛屽疄鏃舵樉绀哄湪灞忓箷鍙充笂瑙掞紙PG 椤电爜涓嬫柟涓€琛岋級銆?
 * 鍗℃鏃剁湅杩欎釜鏁板瓧鍋滃湪浜嗗摢涓細
 *   1=璇籌MU(SPI)  2=鎸夐敭  3=骞宠　/鏃犲埛(涓插彛+鑸垫満+PID)  4=灞忓箷鍒锋柊(SPI)  5=鍏跺畠 */
#define DEBUG_PHASE_DISPLAY_ENABLE (0)
volatile uint32_t g_debug_phase = 0;
static void debug_show_phase(uint32_t p)
{
#if DEBUG_PHASE_DISPLAY_ENABLE
    ips200_show_int(280, 16, (int32_t)p, 1);
#else
    FSP_PARAMETER_NOT_USED(p);
#endif
}

/*******************************************************************************************************************//**
 * main() is generated by the RA Configuration editor and is used to generate threads if an RTOS is used.  This function
 * is called by main() when no RTOS is used.
 **********************************************************************************************************************/
void hal_entry(void)
{
    fsp_err_t err;
#if RUN_IMU660RB_TEST
    bsp_io_level_t readLevel;
#endif

    /* Open the transfer instance with initial configuration. */
    debug_init();

    /* 浣胯兘 DWT 鍛ㄦ湡璁℃暟鍣細涓诲惊鐜敤瀹冨涓ゆ IMU 閲囨牱涔嬮棿鍋氱簿纭鏃讹紝
     * 璁╁Э鎬佽В绠楃殑绉垎姝ラ暱璺熼殢鐪熷疄鑰楁椂锛堟憚鍍忓ご鍒峰浘浼氭媺闀夸富寰幆锛夈€?*/
    *(volatile uint32_t *) DEMCR_REG      |= (1UL << 24);   /* TRCENA */
    *(volatile uint32_t *) DWT_CTRL_REG   |= (1UL << 0);    /* CYCCNTENA */
    *(volatile uint32_t *) DWT_CYCCNT_REG  = 0UL;

    /*Initialize the IOPORT module and configure the pins
     * Note: The default pin configuration name in the RA Configuration tool is g_bsp_pin_cfg */
    err = g_ioport.p_api->open(g_ioport.p_ctrl, g_ioport.p_cfg);
    assert(FSP_SUCCESS == err);

#if RUN_IPS200_DISPLAY
    ips200_set_dir(IPS200_CROSSWISE_180);
    ips200_init();
    ips200_set_color(RGB565_GREEN, RGB565_BLACK);
    ips200_clear();
#if RUN_SERVO_HOLD_TEST
    ips200_show_string(10, 10, "SERVO HOLD TEST");
    ips200_show_string(10, 35, "CH1 P105 P7-1");
    ips200_show_string(10, 60, "CH2 P104 P7-3");
    ips200_show_string(10, 85, "CH3 PD06 P7-5");
    ips200_show_string(10, 110, "CH4 P102 P7-7");
    ips200_show_string(10, 135, "PWM 1500us/20ms");
#elif RUN_BRUSHLESS_TEST
    ips200_show_string(10, 10, "BRUSHLESS TEST");
    ips200_show_string(10, 35, "P714 -> DRV RX");
    ips200_show_string(10, 60, "P715 -> DRV TX");
    ips200_show_string(10, 85, "BAUD 460800");
#else
    ips200_show_string(10, 10, "IMU PROC V2");
#endif
#endif

#if RUN_SERVO_HOLD_TEST
    printf("Servo hold test.\r\n");
    printf("CH1 P105 / P7-1.\r\n");
    printf("CH2 P104 / P7-3.\r\n");
    printf("CH3 PD06 / P7-5.\r\n");
    printf("CH4 P102 / P7-7.\r\n");
    printf("Pulse: %u us, period: %u us.\r\n", SERVO_HOLD_PULSE_US, SERVO_HOLD_PERIOD_US);

    servo_hold_init();
    servo_hold_run();
#endif

#if RUN_BRUSHLESS_TEST
    servo_hold_init();
    fsp_err_t brushless_err = brushless_driver_init();
    printf("Brushless init: %d.\r\n", brushless_err);
    printf("Brushless P714 / P6-6 -> driver RX.\r\n");
    printf("Brushless P715 / P6-4 -> driver TX.\r\n");
    printf("Brushless baud: %u.\r\n", BRUSHLESS_DRIVER_BAUDRATE);

#if RUN_IPS200_DISPLAY
    if(FSP_SUCCESS == brushless_err)
    {
        ips200_show_string(10, 110, "INIT OK ");
    }
    else
    {
        ips200_show_string(10, 110, "INIT ERR");
        ips200_show_int(90, 110, brushless_err, 4);
    }
#endif

    if(FSP_SUCCESS == brushless_err)
    {
        uint32_t test_time_ms = 0;

        while(test_time_ms < 500U)
        {
            servo_hold_refresh_pulse(SERVO_HOLD_PULSE_US);
            R_BSP_SoftwareDelay(BRUSHLESS_TEST_STEP_MS - 2U, BSP_DELAY_UNITS_MILLISECONDS);
            test_time_ms += BRUSHLESS_TEST_STEP_MS;
        }
        test_time_ms = 0;
        while(test_time_ms < BRUSHLESS_TEST_TIME_MS)
        {
            (void) brushless_driver_set_duty(BRUSHLESS_TEST_LEFT, BRUSHLESS_TEST_RIGHT);
            servo_hold_refresh_pulse(SERVO_HOLD_PULSE_US);
            R_BSP_SoftwareDelay(BRUSHLESS_TEST_STEP_MS - 2U, BSP_DELAY_UNITS_MILLISECONDS);
            test_time_ms += BRUSHLESS_TEST_STEP_MS;
        }
        printf("Brushless pulse duty L:%d R:%d, time: %d ms.\r\n",
               BRUSHLESS_TEST_LEFT,
               BRUSHLESS_TEST_RIGHT,
               BRUSHLESS_TEST_TIME_MS);
#if RUN_IPS200_DISPLAY
        ips200_show_string(125, 110, "D:");
        ips200_show_int(150, 110, BRUSHLESS_TEST_DUTY, 5);
#endif
        (void) brushless_driver_set_duty(0, 0);
#if RUN_IPS200_DISPLAY
        ips200_show_string(125, 110, "D:");
        ips200_show_int(150, 110, 0, 5);
#endif
    }

    while(true)
    {
        brushless_driver_status_t status;

        brushless_driver_get_status(&status);
        printf("MOTOR speed L:%d R:%d bytes:%lu frames:%lu err:%lu last:0x%02X tx:%lu txerr:%d.\r\n",
               status.left_speed,
               status.right_speed,
               status.rx_byte_count,
               status.rx_frame_count,
               status.rx_error_count,
               status.last_rx_byte,
               status.tx_frame_count,
               status.last_tx_error);

#if RUN_IPS200_DISPLAY
        ips200_show_string(10, 135, "L:");
        ips200_show_int(35, 135, status.left_speed, 6);
        ips200_show_string(125, 135, "R:");
        ips200_show_int(150, 135, status.right_speed, 6);
        ips200_show_string(10, 160, "FR:");
        ips200_show_int(40, 160, (int32) status.rx_frame_count, 6);
        ips200_show_string(125, 160, "ER:");
        ips200_show_int(155, 160, (int32) status.rx_error_count, 6);
        ips200_show_string(10, 185, "BY:");
        ips200_show_int(40, 185, (int32) status.rx_byte_count, 7);
        ips200_show_string(125, 185, "LB:");
        ips200_show_int(155, 185, (int32) status.last_rx_byte, 4);
        ips200_show_string(10, 210, "TX:");
        ips200_show_int(40, 210, (int32) status.tx_frame_count, 7);
        ips200_show_string(125, 210, "TE:");
        ips200_show_int(155, 210, (int32) status.last_tx_error, 4);
#endif
        servo_hold_refresh_pulse(SERVO_HOLD_PULSE_US);
        R_BSP_SoftwareDelay(BRUSHLESS_TEST_STEP_MS - 2U, BSP_DELAY_UNITS_MILLISECONDS);
    }
#endif

#if RUN_IMU660RB_TEST
    printf("IMU660RB test.\r\n");
    printf("IMU660RB SCL  P601.\r\n");
    printf("IMU660RB SDI  P603.\r\n");
    printf("IMU660RB SDO  P602.\r\n");
    printf("IMU660RB CS   P604.\r\n");

    while(1)
    {
        if(!imu660rb_init())
        {
            printf("IMU660RB init success.\r\n");
            imu660rb_get_gyro();
            imu660rb_get_acc();
            imu_process_init(IMU_PROCESS_DEFAULT_CYCLE_S);
            balance_control_init();
            tof_follow_init();
            key_tune_init();
            nag_navigation_init();
            fsp_err_t voice_err = voice_control_init();
            printf("Voice ctrl init: %d. P802 SCI2 RX @ %u baud.\r\n", voice_err, (unsigned) VOICE_CONTROL_BAUDRATE);
            fsp_err_t receiver_err = uart_receiver_init();
            printf("Remote receiver init: %d. P909 SCI6 RX @ %u baud, 8E2.\r\n",
                   receiver_err,
                   (unsigned)UART_RECEIVER_BAUDRATE);
            uint8 dl1b_err = dl1b_init();
            printf("DL1B init: %u. SCL P515, SDA P514, XS P402, polling mode.\r\n", (unsigned)dl1b_err);
#if RUN_IPS200_DISPLAY
            imu_angle_display_init();
#endif
            printf("Camera init...\r\n");
            camera_display_init();   /* 鏈夐檺閲嶈瘯锛屾憚鍍忓ご娌℃帴涔熶笉褰卞搷灏忚溅 */
            break;
        }
        printf("IMU660RB init failed, try again.\r\n");
#if RUN_IPS200_DISPLAY
        ips200_show_string(10, 35, "IMU init failed ");
#endif
        R_BSP_SoftwareDelay(500, BSP_DELAY_UNITS_MILLISECONDS);
    }
#elif !RUN_SERVO_HOLD_TEST && !RUN_BRUSHLESS_TEST
    printf("IPS200 display test.\r\n");
#endif

#if RUN_IMU660RB_TEST
    uint32_t last_dwt_tick = 0U;
    while(true)
    {
        R_BSP_SoftwareDelay(5, BSP_DELAY_UNITS_MILLISECONDS);
        /* 瀹炴祴涓婁竴鍦堜富寰幆鎬昏€楁椂锛堝惈鎽勫儚澶村埛鍥剧瓑闃诲锛夛紝浣滀负濮挎€佽В绠楃Н鍒嗘闀?*/
        uint32_t now_dwt = *(volatile uint32_t *) DWT_CYCCNT_REG;
        uint32_t delta_dwt = now_dwt - last_dwt_tick;
        last_dwt_tick = now_dwt;
        float imu_cycle_s = (float) delta_dwt / (float) SystemCoreClock;
        if((imu_cycle_s < 0.001f) || (imu_cycle_s > 0.25f))
        {
            imu_cycle_s = 0.005f;
        }
        g_debug_phase = 1;
        if(!camera_display_mode_active()) { debug_show_phase(1); }
        imu_process_update(imu_cycle_s);
        g_debug_phase = 2;
        if(!camera_display_mode_active()) { debug_show_phase(2); }
        key_tune_update(); voice_control_process(); uart_receiver_process();
        g_debug_phase = 3;
        if(!camera_display_mode_active()) { debug_show_phase(3); }
        balance_control_update();
        nag_navigation_update();
#if RUN_IPS200_DISPLAY
        /* 鍏堝鐞嗘憚鍍忓ご妯″紡鍒囨崲锛堝繀椤诲湪璋冭瘯鐢婚潰涔嬪墠锛夛紝
         * 纭繚璇煶鎸囦护杩涘叆/閫€鍑烘憚鍍忓ご妯″紡鍚庯紝璋冭瘯鐢婚潰绔嬪嵆鍝嶅簲锛?
         * 閬垮厤涓婁竴甯х殑璋冭瘯鏂囧瓧娈嬬暀鍒版憚鍍忓ご鐢婚潰涓娿€?*/
        camera_display_process();
        if(!camera_display_mode_active())
        {
            g_debug_phase = 4; debug_show_phase(4);
            imu_angle_display_update(-imu_roll_balance.posture_value.yaw,
                                     imu_roll_balance.posture_value.pit,
                                     imu_roll_balance.posture_value.rol);
        }
#endif
        g_debug_phase = 5;
        g_ioport.p_api->pinRead(&g_ioport_ctrl, BSP_IO_PORT_01_PIN_10, &readLevel);
        g_ioport.p_api->pinWrite(&g_ioport_ctrl, BSP_IO_PORT_01_PIN_10, BSP_IO_LEVEL_HIGH - readLevel);
    }
#elif !RUN_SERVO_HOLD_TEST && !RUN_BRUSHLESS_TEST
    ips200_set_dir(IPS200_CROSSWISE_180);
    ips200_init();
    ips200_set_color(RGB565_WHITE, RGB565_BLACK);
    ips200_clear();
    ips200_show_string(20, 30, "Hello RA8P1!");
    ips200_show_string(20, 60, "IPS200 OK");

    while(true)
    {
        R_BSP_SoftwareDelay(1000, BSP_DELAY_UNITS_MILLISECONDS);
    }
#endif
}






